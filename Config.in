## Config.in
```kconfig
# Copyright (C) 2006-2013 OpenWrt.org
#
# This is free software, licensed under the GNU General Public License v2.
# See /LICENSE for more information.
#

mainmenu "X Router Configuration"

menu "Generic options"

config ARCH
	string 
	default "arm" if ARM
	default "arm64" if ARM64

choice 
	prompt "ARCH"
	default ARM

config ARM
	bool "arm"

config ARM64
	bool "arm64"

endchoice

config TARBALL_DIR
	string "tarball directory"
	default "/work/tar"

endmenu

source toolchain/Config.in
source kernel/Config.in
source app/Config.in
```

## app/Config.in
```kconfig
menu "App options"

menuconfig BUSYBOX
	bool "busybox"
	default y

config BUSYBOX_VER
	string "version"
	default "1.31.1"
	depends on BUSYBOX

menuconfig LIBMNL
	bool "libmnl"
	default y

config LIBMNL_VER
	string "version"
	default "1.0.4"
	depends on LIBMNL

menuconfig LIBNFTNL
	bool "libnftnl"
	default y
	select LIBMNL

config LIBNFTNL_VER
	string "version"
	default "1.1.5"
	depends on LIBNFTNL

menuconfig LIBNL
	bool "libnl"
	default y

config LIBNL_VER
	string "version"
	default "3.2.25"
	depends on LIBNL

menuconfig DNSMASQ
	bool "dnsmasq"
	default y

config DNSMASQ_VER
	string "version"
	default "2.80"
	depends on DNSMASQ

menuconfig BOA
	bool "boa"
	default y

config BOA_VER
	string "version"
	default "debian-0.94.14rc21-5"
	depends on BOA


menuconfig IPTABLES
	bool "iptables"
	default y

config IPTABLES_VER
	string "version"
	default "1.8.4"
	depends on IPTABLES

menuconfig NFTABLES
	bool "nftables"
	default y
	select LIBMNL
	select LIBNFTNL

config NFTABLES_VER
	string "version"
	default "0.9.3"
	depends on NFTABLES

menuconfig LIBPCAP
	bool "libpcap"
	default n

config LIBPCAP_VER
	string "version"
	default "1.9.1"
	depends on LIBPCAP

menuconfig TCPDUMP
	bool "tcpdump"
	default y
	select LIBPCAP

config TCPDUMP_VER
	string "version"
	default "4.9.3"
	depends on TCPDUMP

menuconfig IW
	bool "iw"
	default y
	select LIBNL

config IW_VER
	string "version"
	default "5.0.1"
	depends on IW

menuconfig MAC80211
	bool "mac80211"
	default y

config MAC80211_VER
	string "backports version"
	default "4.19.32-1"
	depends on MAC80211

menuconfig ATH10K_CT
	bool "ath10k-ct"

config ATH10K_CT_VER
	string "version"
	default "2019-05-08-f98b6dc4"
	depends on ATH10K_CT

config ATH10K_CT_CTVER
	string "kernel version"
	depends on ATH10K_CT

menuconfig HOSTAPD
	bool "hostapd"
	default y
	select LIBNL

config HOSTAPD_VER
	string "version"
	default "2.9"
	depends on HOSTAPD

menuconfig WPA_SUPPLICANT
	bool "wpa_supplicant"
	default y

menuconfig WPA_SUPPLICANT_VER
	string "version"
	default "2.9"
	depends on WPA_SUPPLICANT
	
menu "Xrouter App"

config LIBBASE
	bool "libbase"
	default y

config LOG
	bool "log"
	select LIBBASE
	default y

config CONFIG
	bool "config"
	select LIBBASE
	select LOG
	default y

config XBUS
	bool "xbus"
	select LIBBASE
	default y

config UTILS
	bool "utils"
	select LIBBASE
	default y

config NETMAN
	bool "netman"
	select LIBBASE
	select LOG
	select CONFIG
	select XBUS
	default y

config SWITCH
	bool "switch"
	select LIBBASE
	select LOG

config WEBCGI
	bool "webcgi"
	select LIBBASE
	select SWITCH
	select LOG
	select CONFIG
	
endmenu

endmenu
```

## kernel/Config.in
```kconfig
menu "Kernel options"

config KERNEL_VER
	string
	default "4.14.120" if KERNEL_4_14_120

choice
	prompt "kernel version"

config KERNEL_4_14_120
	bool "4.14.120"

endchoice

endmenu
```

## targets/ipq4018/fit-image.its
```
/dts-v1/;

/ {
	description = "X-router Fit Image";
	#address-cells = <1>;

	images {
		kernel {
			description = "OpenWrt Linux kernel";
			data = /incbin/("linux-4.14.120/arch/arm/boot/zImage");
			type = "kernel";
			arch = "arm";
			os = "linux";
			compression = "none";
			load = <0x80208000>;
			entry = <0x80208000>;
			hash-1 {
				algo = "sha1";
			};
		};
		fdt {
			description = "Flattened Device Tree blob";
			data = /incbin/("linux-4.14.120/arch/arm/boot/dts/qcom-ipq4019-ap.dk01.1-c1.dtb");
			type = "flat_dt";
			arch = "arm";
			compression = "none";
			hash-1 {
				algo = "sha1";
			};
		};
		initramfs {
			description = "Compressed Initramfs";
			data = /incbin/("initramfs.cpio.xz");
			type = "ramdisk";
			arch = "arm";
			os = "linux";
			compression = "none";
			load = <0x80208000>;
			entry = <0x80208000>;
			hash-1 {
				algo = "sha1";
			};
		};
	};

	configurations {
		default = "config@1";
		config@1 {
			description = "IPQ4018 Linux kernel with FDT blob and initramfs";
			kernel = "kernel";
			fdt = "fdt";
			ramdisk = "initramfs";
		};
	};
};
```

## toolchain/Config.in
```kconfig
menu "Toolchain options"

config CTNG_NAME
	string
	default "crosstool-ng-1.24.0" if CTNG_1_24_0

choice
	prompt "crosstool-ng version"

config CTNG_1_24_0
	bool "1.24.0"

endchoice

config TOOLCHAIN_NAME
	string "toolchain name"
	help
		define the toolchain top dir /opt/$CONFIG_TOOLCHAIN_NAME

config TOOLCHAIN_TARGET_TUPLE
	string "toolchain target tuple"
	help
		toolchain target e.g. arm-linux-gnueabihf
		used for cross compile, passed to --host of ./configure
		used to construct cross compile prefix
		used to construct sysroot

config TOOLCHAIN_LIBS
	string "toolchain libs installed to rootfs"
	default "ld libc libm libdl libpthread libresolv"

config TOOLCHAIN_DEBUG_BINS
	string "toolchain bins for bug e.g. gdbserver, strace"
	default "gdbserver ltrace strace"

endmenu
```
